## conf/layer.conf
```bitbake
# We have a conf and classes directory, add to BBPATH
BBPATH =. "${LAYERDIR}:"

# We have recipes-* directories, add to BBFILES
BBFILES += "${LAYERDIR}/recipes-*/*/*.bb \
            ${LAYERDIR}/recipes-*/*/*.bbappend"

BBFILE_COLLECTIONS += "pyside-layer"
BBFILE_PATTERN_pyside-layer := "^${LAYERDIR}/"
BBFILE_PRIORITY_pyside-layer = "10"

LAYERSERIES_COMPAT_pyside-layer = "honister kirkstone"

# This should only be incremented on significant changes that will
# cause compatibility issues with other layers
LAYERVERSION_pyside-layer = "1"

LAYERDEPENDS_pyside-layer = "core openembedded-layer clang-layer qt6-layer"
```
